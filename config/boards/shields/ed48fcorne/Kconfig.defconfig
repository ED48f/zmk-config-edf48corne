## config/boards/shields/ed48fcorne/Kconfig.defconfig
```kconfig
# Copyright (c) 2022 The ZMK Contributors
# SPDX-License-Identifier: MIT

if SHIELD_ED48FCORNE_LEFT

config ZMK_KEYBOARD_NAME
    default "EDF48 Corne"

config ZMK_SPLIT_ROLE_CENTRAL
    default y

endif

if SHIELD_ED48FCORNE_LEFT || SHIELD_ED48FCORNE_RIGHT

config ZMK_SPLIT
    default y

if ZMK_DISPLAY

config I2C
    default y

config SSD1306
    default y

endif # ZMK_DISPLAY

if LVGL

config LV_Z_VDB_SIZE
    default 64

config LV_DPI_DEF
    default 148

config LV_Z_BITS_PER_PIXEL
    default 1

choice LV_COLOR_DEPTH
    default LV_COLOR_DEPTH_1
endchoice

endif # LVGL

endif

config NICE_EPAPER_ON
    bool "Enable nice view widget compatibility"
    default n

if !NICE_EPAPER_ON

if SHIELD_NICE_OLED

config LV_Z_VDB_SIZE
    default 64 if SHIELD_NICE_OLED
    # default 100 if !SHIELD_NICE_OLED

config LV_DPI_DEF
    default 148 if SHIELD_NICE_OLED
    # default 161 if !SHIELD_NICE_OLED

config LV_Z_BITS_PER_PIXEL
    default 1

choice LV_COLOR_DEPTH
    default LV_COLOR_DEPTH_1
endchoice

choice ZMK_DISPLAY_WORK_QUEUE
    default ZMK_DISPLAY_WORK_QUEUE_DEDICATED
endchoice

choice ZMK_DISPLAY_STATUS_SCREEN
    default ZMK_DISPLAY_STATUS_SCREEN_CUSTOM
endchoice

config LV_Z_MEM_POOL_SIZE
    default 4096 if ZMK_DISPLAY_STATUS_SCREEN_CUSTOM

config ZMK_DISPLAY_STATUS_SCREEN_CUSTOM
    imply NICE_VIEW_WIDGET_STATUS

config NICE_OLED_GEM_ANIMATION_WPM_FIXED_RANGE
    bool "Enable fixed range for WPM gauge/chart"
    default y

config NICE_OLED_GEM_ANIMATION_WPM_FIXED_RANGE_MAX
    int "Fixed range maximum for WPM gauge/chart"
    default 100

config NICE_OLED_GEM_ANIMATION
    bool "Enable animation on peripheral"
    default y

config NICE_OLED_GEM_ANIMATION_SMART_BATTERY
    bool "Enable animation on peripheral VERY EXPERIMENTAL!!"
    default n

config NICE_OLED_GEM_ANIMATION_MS
    int "Animation length in milliseconds"
    default 960

config NICE_OLED_POKEMON_ANIMATION
    bool "Enable animation on peripheral"
    default n

config NICE_OLED_POKEMON_ANIMATION_MS
    int "Animation length in milliseconds"
    default 4800

config NICE_OLED_VIM
    bool "Enable static vim on peripheral"
    default n

config NICE_OLED_VIP_MARCOS
bool "Enable static vim_marcos on peripheral"
    default n

config NICE_OLED_WIDGET_MASTER_TEST
    bool "Enable test widget on master"
    default n

config NICE_OLED_WIDGET_PERIPHERAL_TEST
    bool "Enable test widget on peripheral"
    default n

config NICE_OLED_WIDGET_DONGLE_TEST
    bool "Enable test widget on dongle"
    default n

config NICE_VIEW_WIDGET_STATUS
    select LV_USE_LABEL
    select LV_USE_IMG
    select LV_USE_CANVAS
    select LV_USE_ANIMIMG
    select LV_USE_ANIMATION

config NICE_VIEW_WIDGET_INVERTED
    bool "Invert display colors"

if !ZMK_SPLIT || ZMK_SPLIT_ROLE_CENTRAL

config NICE_VIEW_WIDGET_STATUS
    select ZMK_WPM

### NICE OLED WIDGET LAYER RGB TODO:
config NICE_OLED_WIDGET_LAYER_RGB
    bool "Enable layer rgb widget"
    default n

endif # !ZMK_SPLIT || ZMK_SPLIT_ROLE_CENTRAL

endif # SHIELD_NICE_OLED
endif # NICE_EPAPER_ON

if SHIELD_NICE_OLED || SHIELD_NICE_EPAPER
if !ZMK_SPLIT || ZMK_SPLIT_ROLE_CENTRAL

### NICE OLED WIDGET WPM
config NICE_OLED_WIDGET_WPM
    bool "Enable Nice OLED WPM Widget"
    default y

if NICE_OLED_WIDGET_WPM

config NICE_OLED_WIDGET_WPM_LUNA
    bool "Enable wpm luna"
    default y

if NICE_OLED_WIDGET_WPM_LUNA

config NICE_OLED_WIDGET_WPM_LUNA_ANIMATION_MS
    int "Luna Animation in ms for WPM Widget"
    default 300

endif # NICE_OLED_WIDGET_WPM_LUNA

endif # NICE_OLED_WIDGET_WPM

### NICE OLED WIDGET HID INDICATORS
config NICE_OLED_WIDGET_HID_INDICATORS
    bool "Enable HID indicators"
    default y

if NICE_OLED_WIDGET_HID_INDICATORS

config ZMK_HID_INDICATORS
    bool "Enable HID indicators"
    default y

config NICE_OLED_WIDGET_HID_INDICATORS_LUNA
    bool "Enable HID indicators luna"
    default y

config NICE_OLED_WIDGET_HID_INDICATORS_LUNA_ONLY_CAPSLOCK
    bool "Enable HID indicators luna only on CapsLock"
    default n

if NICE_OLED_WIDGET_HID_INDICATORS_LUNA

config NICE_OLED_WIDGET_HID_INDICATORS_LUNA_ANIMATION_MS
    int "Luna Animation in ms for HID Indicators"
    default 300

endif # NICE_OLED_WIDGET_HID_INDICATORS_LUNA

endif # NICE_OLED_WIDGET_HID_INDICATORS

### NICE OLED WIDGET MODIFIERS INDICATORS
config NICE_OLED_WIDGET_MODIFIERS_INDICATORS
    bool "Enable modifiers indicators"
    default y

if NICE_OLED_WIDGET_MODIFIERS_INDICATORS

config NICE_OLED_WIDGET_MODIFIERS_INDICATORS_LUNA
    bool "Enable modifiers indicators luna"
    default y

if NICE_OLED_WIDGET_MODIFIERS_INDICATORS_LUNA

config NICE_OLED_WIDGET_MODIFIERS_INDICATORS_LUNA_ANIMATION_MS
    int "Luna Animation in ms for Modifiers Indicators"
    default 300

endif # NICE_OLED_WIDGET_MODIFIERS_INDICATORS_LUNA
endif # NICE_OLED_WIDGET_MODIFIERS_INDICATORS
endif # !ZMK_SPLIT || ZMK_SPLIT_ROLE_CENTRAL
endif # SHIELD_NICE_OLED || SHIELD_NICE_EPAPER

if NICE_EPAPER_ON
rsource "nice_epaper/Kconfig.defconfig"
endif # NICE_EPAPER_ON
```

## config/boards/shields/ed48fcorne/board.yml
```yaml
board:
  name: nice_nano_left
  vendor: ed48fcorne_left
  name: nice_nano_right
  vendor: ed48fcorne_right
      ...
  socs:
  - name: nrf52840
      ...
```

## config/boards/shields/edf48corne/Kconfig.defconfig
```kconfig
if SHIELD_Eed48fcorne_LEFT

config ZMK_KEYBOARD_NAME
    default "ED48F CORNE"

config ZMK_SPLIT_ROLE_CENTRAL
    default y

endif

if SHIELD_CORNE_LEFT || SHIELD_CORNE_RIGHT

config ZMK_SPLIT
    default y
```

## config/boards/shields/edf48corne/Kconfig.shield
```kconfig
# Copyright (c) 2020 Pete Johanson
# SPDX-License-Identifier: MIT

config SHIELD_ed48fcorne_LEFT
    def_bool $(shields_list_contains,ed48fcorne_left)

config SHIELD_ed48fcorne_RIGHT
    def_bool $(shields_list_contains,ed48fcorne_right)
```

## config/boards/shields/edf49fcorne/Kconfig.defconfig
```kconfig
if SHIELD_ed48fcorne_left

config ZMK_KEYBOARD_NAME
    default "ED48F CORNE"

config ZMK_SPLIT_ROLE_CENTRAL
    default y

endif

if SHIELD_ed48fcorne_left || SHIELD_ed48fcorne_right

config ZMK_SPLIT
    default y
```

## config/boards/shields/edf49fcorne/Kconfig.shield
```kconfig
# Copyright (c) 2020 Pete Johanson
# SPDX-License-Identifier: MIT

config SHIELD_ED48FCORNE_LEFT
    def_bool $(shields_list_contains,ed48fcorne_left)

config SHIELD_ED48FCORNE_RIGHT
    def_bool $(shields_list_contains,ed48fcorne_right)
```

## config/west.yml
```yaml
manifest:
  remotes:
    - name: zmkfirmware
      url-base: https://github.com/zmkfirmware
  projects:
    - name: zmk
      remote: zmkfirmware
      revision: main
      import: app/west.yml
   # support nice_oled and nice_epaper
    - name: zmk-nice-oled
      remote: mctechnology17
      revision: main
  self:
    path: config
```
